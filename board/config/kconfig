## board/config/kconfig
```kconfig
mainmenu "EtherNet project configuration"

source "platform_common/core/stm32f7xx/config/kconfig"

menu "Operating system"

comment "FreeRTOS heap_4, dynamic allocation; shared HAL/RTOS tick fixed at 1000 Hz"

config RTOS_USE_TIMERS
    bool "Enable software timers"
    default y

config RTOS_MAX_SYSCALL_INTERRUPT_PRIORITY
    int "Lowest numeric IRQ priority allowed to call FromISR APIs"
    range 1 15
    default 5
    help
      STM32F767 uses four NVIC priority bits. Numerically smaller priorities
      are more urgent and must not call FreeRTOS FromISR APIs.

endmenu

source "platform_application/task/kconfig"
source "platform_common/RTT/Config/kconfig"
```
