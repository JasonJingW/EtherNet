ENTRY(Reset_Handler)

MEMORY
{
    FLASH (rx)  : ORIGIN = 0x08000000, LENGTH = @CHIP_FLASH_SIZE_BYTES@
    DTCM  (rw)  : ORIGIN = 0x20000000, LENGTH = @CHIP_DTCM_SIZE_BYTES@ - @GCC_MAIN_STACK_SIZE@
    STACK (rw)  : ORIGIN = 0x20000000 + @CHIP_DTCM_SIZE_BYTES@ - @GCC_MAIN_STACK_SIZE@, LENGTH = @GCC_MAIN_STACK_SIZE@
    NOCACHE (rw) : ORIGIN = 0x20020000, LENGTH = @CHIP_NONCACHE_RAM_SIZE_BYTES@
    RAM   (rwx) : ORIGIN = 0x20020000 + @CHIP_NONCACHE_RAM_SIZE_BYTES@,
                  LENGTH = @CHIP_SRAM1_SIZE_BYTES@ + @CHIP_SRAM2_SIZE_BYTES@ - @CHIP_NONCACHE_RAM_SIZE_BYTES@
}

PHDRS
{
    flash PT_LOAD FLAGS(5);
    ram   PT_LOAD FLAGS(6);
    stack PT_LOAD FLAGS(6);
}

SECTIONS
{
    .isr_vector :
    {
        . = ALIGN(512);
        KEEP(*(.isr_vector))
    } > FLASH :flash
    .text :
    {
        . = ALIGN(4);
        *(.text .text.*)
        KEEP(*(.init))
        KEEP(*(.fini))
        *(.rodata .rodata.*)
        . = ALIGN(4);
        _etext = .;
    } > FLASH :flash
    .ARM.extab : { *(.ARM.extab* .gnu.linkonce.armextab.*) } > FLASH :flash
    .ARM.exidx :
    {
        __exidx_start = .;
        *(.ARM.exidx* .gnu.linkonce.armexidx.*)
        __exidx_end = .;
    } > FLASH :flash
    .preinit_array :
    {
        PROVIDE_HIDDEN(__preinit_array_start = .);
        KEEP(*(.preinit_array*))
        PROVIDE_HIDDEN(__preinit_array_end = .);
    } > FLASH :flash
    .init_array :
    {
        PROVIDE_HIDDEN(__init_array_start = .);
        KEEP(*(SORT(.init_array.*)))
        KEEP(*(.init_array*))
        PROVIDE_HIDDEN(__init_array_end = .);
    } > FLASH :flash
    .fini_array :
    {
        PROVIDE_HIDDEN(__fini_array_start = .);
        KEEP(*(SORT(.fini_array.*)))
        KEEP(*(.fini_array*))
        PROVIDE_HIDDEN(__fini_array_end = .);
    } > FLASH :flash
    _sidata = LOADADDR(.data);
    .data :
    {
        . = ALIGN(4);
        _sdata = .;
        *(.data .data.*)
        . = ALIGN(4);
        _edata = .;
    } > RAM AT> FLASH :ram
    .bss (NOLOAD) :
    {
        . = ALIGN(4);
        _sbss = .;
        __bss_start__ = .;
        *(.bss .bss.*)
        *(COMMON)
        . = ALIGN(4);
        _ebss = .;
        __bss_end__ = .;
    } > RAM :ram
    .noinit (NOLOAD) : { *(.noinit .noinit.*) } > RAM :ram
    . = ALIGN(8);
    PROVIDE(end = .);
    PROVIDE(_end = .);
    .noncache (NOLOAD) :
    {
        *(.noncache.rtt.control)
        *(.noncache .noncache.*)
    } > NOCACHE :NONE
    __noncache_start__ = ORIGIN(NOCACHE);
    __noncache_end__ = ORIGIN(NOCACHE) + LENGTH(NOCACHE);
    .stack (NOLOAD) :
    {
        __StackLimit = .;
        . += @GCC_MAIN_STACK_SIZE@;
        __StackTop = .;
    } > STACK :stack
    _estack = __StackTop;
    .ARM.attributes 0 : { *(.ARM.attributes) } :NONE
    /DISCARD/ : { *(.note.GNU-stack) }
}
ASSERT(__StackTop == 0x20000000 + @CHIP_DTCM_SIZE_BYTES@, "Invalid main stack placement")
ASSERT(LENGTH(NOCACHE) == 16K, "Non-cacheable RAM size must match the MPU region")
ASSERT((ORIGIN(NOCACHE) % LENGTH(NOCACHE)) == 0, "Non-cacheable RAM must align to the MPU region size")
ASSERT(DEFINED(_SEGGER_RTT) ? _SEGGER_RTT == ORIGIN(NOCACHE) : 1, "RTT control block must start the non-cacheable RAM region")
